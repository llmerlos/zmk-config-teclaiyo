## config/boards/shields/aokb/Kconfig.defconfig
```kconfig
if SHIELD_TECLAIYO_RIGHT

config ZMK_KEYBOARD_NAME
    default "TECLAIYO"

config ZMK_SPLIT_ROLE_CENTRAL
    default y

endif

if SHIELD_TECLAIYO_LEFT || SHIELD_TECLAIYO_RIGHT

config ZMK_SPLIT
    default y

endif
```

## config/boards/shields/aokb/Kconfig.shield
```kconfig
# Copyright (c) 2020 Pete Johanson
# SPDX-License-Identifier: MIT

config SHIELD_TECLAIYO_LEFT
	def_bool $(shields_list_contains,teclaiyo_left)

config SHIELD_TECLAIYO_RIGHT
	def_bool $(shields_list_contains,teclaiyo_right)
```
